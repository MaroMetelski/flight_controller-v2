## app/boards/arm/nucleo_f072rb/Kconfig.board
```kconfig
# NUCLEO_F072RB board configuration

# Copyright (c) 2018 qianfan Zhao
# SPDX-License-Identifier: Apache-2.0

config BOARD_NUCLEO_F072RB
	bool "NUCLEO-64 F072RB Development Board"
	depends on SOC_STM32F072XB
```

## app/boards/arm/nucleo_f072rb/Kconfig.defconfig
```kconfig
# NUCLEO_F072RB board configuration

# Copyright (c) 2018 qianfan Zhao
# SPDX-License-Identifier: Apache-2.0

if BOARD_NUCLEO_F072RB

config BOARD
	default "nucleo_f072rb"

config SPI_STM32_INTERRUPT
	default y
	depends on SPI

endif # BOARD_NUCLEO_F072RB
```

## app/dts/bindings/motor-pwms.yaml
```yaml
description: DC motor PWMs parent node

compatible: "motor-pwms"

properties:
  fr-pwm:
    type: phandle
    required: true
    description: |
      Front right motor PWM
  fl-pwm:
    type: phandle
    required: true
    description: |
      Front left motor PWM
  br-pwm:
    type: phandle
    required: true
    description: |
      Back right motor PWM
  bl-pwm:
    type: phandle
    required: true
    description: |
      Back left motor PWM
```

## app/dts/bindings/receiver-pwms.yaml
```yaml
description: Radio Receiver PWMs parent node

compatible: "receiver-pwms"

properties:
  pwms:
    type: phandle-array
    required: true
    description: |
      PWM input channels for radio receiver PWM output signal
```

## app/west.yml
```yaml
manifest:
  self:
    path: app
  defaults:
    remote: zephyrproject-rtos
  remotes:
    - name: zephyrproject-rtos
      url-base: https://github.com/zephyrproject-rtos

  projects:
    - name: zephyr
      revision: v3.1.0
      path: zephyr
      west-commands: scripts/west-commands.yml
    - name: hal_st
      revision: 52a522ca4a8a9ec1e9bb5bb514e1ab6f102863fe
      path: modules/hal/st
      groups:
        - hal
    - name: hal_stm32
      revision: 51b373cd3455b8c2b9babbf6ff41918116a442ac
      path: modules/hal/stm32
      groups:
        - hal
    - name: cmsis
      revision: 5f86244bad4ad5a590e084f0e72ba7a1416c2edf
      path: modules/hal/cmsis
      groups:
        - hal
```
