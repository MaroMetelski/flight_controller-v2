/ {
    receiver_pwms {
        compatible = "receiver-pwms";
        pwms = <&pwm3 1 0 PWM_POLARITY_NORMAL>,
               <&pwm3 2 0 PWM_POLARITY_NORMAL>;
    };
};

&timers3 {
    st,prescaler = <100>;
    pwm3: pwm {
        pinctrl-0 = <&tim3_ch1_pb4 &tim3_ch2_pb5>;
        pinctrl-names = "default";
        status = "okay";
    };
};
